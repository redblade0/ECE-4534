/**
 * @cliArgs --device "MSPM0G350X" --part "Default" --package "LQFP-64(PM)" --product "mspm0_sdk@2.11.00.07"
 * @versions {"tool":"1.26.2+4477"}
 */

/**
 * Import the modules used in this configuration.
 */
const GPIO   = scripting.addModule("/ti/driverlib/GPIO", {}, false);
const GPIO1  = GPIO.addInstance();
const SYSCTL = scripting.addModule("/ti/driverlib/SYSCTL");
const TIMER  = scripting.addModule("/ti/driverlib/TIMER", {}, false);
const TIMER1 = TIMER.addInstance();

/**
 * Write custom configuration values to the imported modules.
 */
GPIO1.$name                                 = "GPIO_GRP_0";
GPIO1.associatedPins.create(5);
GPIO1.associatedPins[0].$name               = "BOOSTERPACK_LED_RED";
GPIO1.associatedPins[0].assignedPort        = "PORTB";
GPIO1.associatedPins[0].assignedPortSegment = "Lower";
GPIO1.associatedPins[0].assignedPin         = "1";
GPIO1.associatedPins[1].assignedPort        = "PORTA";
GPIO1.associatedPins[1].assignedPin         = "28";
GPIO1.associatedPins[1].assignedPortSegment = "Upper";
GPIO1.associatedPins[1].$name               = "BOOSTERPACK_LED_GREEN";
GPIO1.associatedPins[2].$name               = "BOOSTERPACK_LED_BLUE";
GPIO1.associatedPins[2].assignedPort        = "PORTA";
GPIO1.associatedPins[2].assignedPortSegment = "Upper";
GPIO1.associatedPins[2].assignedPin         = "31";
GPIO1.associatedPins[3].$name               = "BOOSTERPACK_BUTTON_S1";
GPIO1.associatedPins[3].direction           = "INPUT";
GPIO1.associatedPins[3].assignedPort        = "PORTA";
GPIO1.associatedPins[3].internalResistor    = "PULL_UP";
GPIO1.associatedPins[3].assignedPortSegment = "Lower";
GPIO1.associatedPins[3].assignedPin         = "11";
GPIO1.associatedPins[4].$name               = "BOOSTERPACK_BUTTON_S2";
GPIO1.associatedPins[4].direction           = "INPUT";
GPIO1.associatedPins[4].assignedPort        = "PORTA";
GPIO1.associatedPins[4].assignedPortSegment = "Lower";
GPIO1.associatedPins[4].assignedPin         = "12";
GPIO1.associatedPins[4].internalResistor    = "PULL_UP";

const Board = scripting.addModule("/ti/driverlib/Board", {}, false);

SYSCTL.forceDefaultClkConfig = true;

TIMER1.$name       = "TIMER_0";
TIMER1.timerMode   = "PERIODIC_UP";
TIMER1.timerPeriod = "1 ms";
TIMER1.interrupts  = ["ZERO"];

/**
 * Pinmux solution for unlocked pins/peripherals. This ensures that minor changes to the automatic solver in a future
 * version of the tool will not impact the pinmux you originally saw.  These lines can be completely deleted in order to
 * re-solve from scratch.
 */
GPIO1.associatedPins[0].pin.$suggestSolution = "PB1";
GPIO1.associatedPins[1].pin.$suggestSolution = "PA28";
GPIO1.associatedPins[2].pin.$suggestSolution = "PA31";
GPIO1.associatedPins[3].pin.$suggestSolution = "PA11";
GPIO1.associatedPins[4].pin.$suggestSolution = "PA12";
Board.peripheral.$suggestSolution            = "DEBUGSS";
Board.peripheral.swclkPin.$suggestSolution   = "PA20";
Board.peripheral.swdioPin.$suggestSolution   = "PA19";
SYSCTL.peripheral.$suggestSolution           = "SYSCTL";
TIMER1.peripheral.$suggestSolution           = "TIMA0";
